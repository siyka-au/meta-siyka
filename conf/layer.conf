## conf/layer.conf
```bitbake
# We have a conf and classes directory, append to BBPATH
BBPATH .= ":${LAYERDIR}"

# We have a recipes directory, add to BBFILES
BBFILES += "${LAYERDIR}/recipes-*/*/*.bb ${LAYERDIR}/recipes-*/*/*.bbappend"

BBFILE_COLLECTIONS += "meta-siyka"
BBFILE_PATTERN_meta-siyka = "^${LAYERDIR}/"
BBFILE_PRIORITY_meta-siyka = "20"

LAYERSERIES_COMPAT_meta-siyka = "dunfell"
```
